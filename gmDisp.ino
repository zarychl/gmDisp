#include <Adafruit_GFX.h>
#include <Adafruit_SSD1306.h>
#include <mcp_can.h>
#include <SPI.h>

#define SKALA_X1 28
#define SKALA_Y1 22
#define SKALA_X2 118
#define SKALA_Y2 22
#define SKALA_MID (SKALA_X2-SKALA_X1)/2

#define PID_ENGINE_RPM  0x0C
#define PID_COOLANT_TEMP 0x05
#define PID_VEHICLE_SPEED 0x0D

#define CAN_ID_PID 0x7DF //OBD-II CAN frame ID

#define CAN0_INT 2                              // Set INT to pin 2  <--------- CHANGE if using different pin number


int temp = 0;
bool isWarning = 0, isEngineOn = 0, isHLOn = 0, flashState = 0, isCanOk = 0;

long unsigned int rxId;
unsigned char len = 0;
unsigned char rxBuf[8];
char msgString[128];

unsigned long previousMillis = 0;
const long interval = 100;

Adafruit_SSD1306 display(4);
MCP_CAN CAN0(10);

const unsigned char waterIcon [] PROGMEM = {
	0x00, 0x60, 0x00, 0x00, 0x60, 0x00, 0x00, 0x60, 0x00, 0x00, 0x7e, 0x00, 0x00, 0x7e, 0x00, 0x00, 
	0x60, 0x00, 0x00, 0x60, 0x00, 0x00, 0x7e, 0x00, 0x00, 0x60, 0x00, 0x00, 0x60, 0x00, 0x00, 0x7e, 
	0x00, 0x00, 0x7e, 0x00, 0x00, 0x60, 0x00, 0x00, 0xf0, 0x00, 0x20, 0xf0, 0x60, 0xde, 0x77, 0x90, 
	0x8c, 0x61, 0x10, 0x21, 0x08, 0x40, 0x73, 0x9c, 0xe0, 0x0c, 0x63, 0x00
};

const unsigned char opelLogo [] PROGMEM = {
	0x00, 0x00, 0x3f, 0x00, 0x00, 0x00, 0x00, 0x00, 0x00, 0x00, 0x00, 0x00, 0x00, 0x00, 0x00, 0x00, 
	0x00, 0x03, 0xff, 0xe0, 0x00, 0x00, 0x00, 0x00, 0x00, 0x00, 0x00, 0x00, 0x00, 0x00, 0x00, 0x00, 
	0x00, 0x07, 0x80, 0x78, 0x00, 0x00, 0x00, 0x00, 0x00, 0x00, 0x00, 0x00, 0x00, 0x00, 0x00, 0x00, 
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	0x00, 0x00, 0x7f, 0x80, 0x00, 0x00, 0x00, 0x00, 0x00, 0x00, 0x00, 0x00, 0x00, 0x00, 0x00, 0x00
};

void sendPID(unsigned char __pid)
{
  unsigned char tmp[8] = {0x02, 0x01, __pid, 0, 0, 0, 0, 0};

  byte sndStat = CAN0.sendMsgBuf(CAN_ID_PID, 0, 8, tmp);

  if (sndStat == CAN_OK) {
    Serial.print("PID sent: 0x");
    Serial.println(__pid, HEX);
  }
  else {
    Serial.println("Error Sending Message...");
  }
}

int receivePID(unsigned char __pid)
{
    //while(true)
    //{
      if (!digitalRead(CAN0_INT)) {                      // If CAN0_INT pin is low, read receive buffer
      CAN0.readMsgBuf(&rxId, &len, rxBuf);      // Read data: len = data length, buf = data byte(s)

      sprintf(msgString, "Standard ID: 0x%.3lX, DLC: %1d, Data: ", rxId, len);
      Serial.print(msgString);

      for (byte i = 0; i < len; i++) {
        sprintf(msgString, " 0x%.2X", rxBuf[i]);
        Serial.print(msgString);
      }
      
    }
    //Serial.println("");


    switch (__pid) {
      case PID_COOLANT_TEMP:
        if(rxBuf[2] == PID_COOLANT_TEMP){
          uint8_t temp;
          temp = rxBuf[3] - 40;
          return temp;
        }
      break;

      case PID_ENGINE_RPM:
        if(rxBuf[2] == PID_ENGINE_RPM){
          uint16_t rpm;
          rpm = ((256 * rxBuf[3]) + rxBuf[4]) / 4;
          Serial.print("Engine Speed (rpm): ");
          Serial.println(rpm, DEC);
        }
      break;
    }
  }
//}

void setup() {
  Serial.begin(115200);
  display.begin(SSD1306_SWITCHCAPVCC,0x3C);
  display.clearDisplay();
  display.drawBitmap(0, 0, opelLogo, 128, 32, WHITE);
  display.display();
  display.dim(1);
  delay(2000);
  temp = 72;
}

void loop() {
  // sprawdz łączność na can, pobierz temperature, zapisz ja do zmiennej
  
  while(!isCanOk)//zanim połączymy się z samochodem i uzyskamy jakieś dane to zajmiemy czymś użytkownika :)
  {
    //Serial.println("here");
    display.setCursor(41, 25);
    display.setTextColor(WHITE);
    display.setTextSize(1);
    display.print("Sprawdzanie...");
    display.display();

    if (CAN0.begin(MCP_STDEXT, CAN_500KBPS, MCP_8MHZ) == CAN_OK) { //< -------- - CHANGE if using different board
      Serial.println("MCP2515 Initialized Successfully!");
      CAN0.init_Mask(0, 0, 0x07000000);              // Init first mask...
      CAN0.init_Mask(1, 0, 0x07000000);
      for (uint8_t i = 0; i < 6; ++i) {
        CAN0.init_Filt(i, 0, 0x07000000);           //Init filters
      }
    
      CAN0.setMode(MCP_NORMAL);                     // Set operation mode to normal so the MCP2515 sends acks to received data.

      pinMode(CAN0_INT, INPUT); 

      temp = receivePID(PID_COOLANT_TEMP);
      isCanOk = 1;
      
    }
  }

  sendPID(PID_COOLANT_TEMP);

  delay(200); //to allow time for ECU to reply

  temp = receivePID(PID_COOLANT_TEMP);

  display.clearDisplay();

  if(temp >= 115)
  {
    isWarning = 1;
    temp = 115;
  }
  else isWarning = 0;

  int tempSkala = map(temp,65,115,0,SKALA_X2-SKALA_X1);

  if(isWarning)
  {
    unsigned long currentMillis = millis();
    if (currentMillis - previousMillis >= interval) {
      // save the last time you blinked the LED
      previousMillis = currentMillis;

      // if the LED is off turn it on and vice-versa:
      if (flashState == 0) {
        display.fillRect(SKALA_X1, SKALA_Y1-7, tempSkala, 7, WHITE);
        flashState = 1;
      } else {
        flashState = 0;
      }
    }
  }
  else display.fillRect(SKALA_X1, SKALA_Y1-7, tempSkala, 7, WHITE);
  display.drawBitmap(0, 13, waterIcon, 20, 20, WHITE);
  display.drawLine(SKALA_X1,SKALA_Y1,SKALA_X2,SKALA_Y2,WHITE);
  display.drawLine(SKALA_X1,SKALA_Y1,SKALA_X1,SKALA_Y1-7,WHITE);
  display.drawLine(SKALA_X1+SKALA_MID,SKALA_Y1,SKALA_X1+SKALA_MID,SKALA_Y1-7,WHITE);
  display.drawLine(SKALA_X2,SKALA_Y1,SKALA_X2,SKALA_Y1-7,WHITE);
  
  display.setCursor(23, 24);
  display.setTextColor(WHITE);
  display.setTextSize(1);
  display.print("65");

  display.setCursor(23+SKALA_MID, 24);
  display.print("90");

  display.setCursor(110, 24);
  display.print("115");

  Serial.println(temp, DEC);

  //sprawdźmy czy światła nie zostały przełączone
  /*
  if(!(isHLOn && (getHLState() == isHLOn)))
  {
    isHLOn = getHLState();
    display.dim(isHLOn);
  }

  //sprawdźmy czy silnik działa?
  if(!(isEngineOn && (getEngineState() == isEngineOn)))
  {
    isEngineOn = getEngineState();
    //zrob z tym co chcesz
  }
  */
  display.display();
}

//

bool getHLState()
{
}

bool getEngineState()
{
}
